## platforms/esp32/main/Kconfig.projbuild
```kconfig
menu "Microkernel Board"
    choice MK_BOARD
        prompt "Target board"
        default MK_BOARD_AMOLED143

        config MK_BOARD_AMOLED143
            bool "Waveshare AMOLED 1.43 (466x466 SH8601)"

        config MK_BOARD_LCD43B
            bool "Waveshare LCD 4.3B (800x480 ST7262)"
    endchoice
endmenu
```

## platforms/esp32/sdkconfig.defaults
```kconfig
# Custom partition table: 1.94 MB app + 256 KB SPIFFS storage
CONFIG_PARTITION_TABLE_CUSTOM=y
CONFIG_PARTITION_TABLE_CUSTOM_FILENAME="partitions.csv"
CONFIG_ESPTOOLPY_FLASHSIZE_4MB=y

CONFIG_VFS_SUPPORT_SELECT=y
CONFIG_LWIP_USE_ONLY_LWIP_SELECT=n
CONFIG_LWIP_SO_REUSE=y
CONFIG_ESP_MAIN_TASK_STACK_SIZE=16384
CONFIG_ESP_CONSOLE_USB_SERIAL_JTAG=y

# Interactive shell blocks in poll() waiting for UART/USB-JTAG input;
# this starves the IDLE task on single-core chips (C6).
CONFIG_ESP_TASK_WDT_CHECK_IDLE_TASK_CPU0=n

# RISC-V targets (C6/H2) have a hardware stack guard that faults when SP
# leaves the FreeRTOS task stack.  Our WASM fibers deliberately switch to
# malloc'd stacks, so we must disable this.  Xtensa targets are unaffected
# (they ignore this option).
CONFIG_ESP_SYSTEM_HW_STACK_GUARD=n

# PSRAM (S3 modules with octal SPIRAM)
CONFIG_SPIRAM=y
CONFIG_SPIRAM_MODE_OCT=y
CONFIG_SPIRAM_SPEED_80M=y

# WAMR configuration: fast interpreter only, no WASI/pthread (saves RAM)
CONFIG_WAMR_ENABLE_AOT=n
CONFIG_WAMR_ENABLE_LIBC_WASI=n
CONFIG_WAMR_ENABLE_LIB_PTHREAD=n

# SPIFFS filename length: 64 chars for local KV encoded keys
CONFIG_SPIFFS_OBJ_NAME_LEN=64

# ── Size optimizations ────────────────────────────────────────────────
# Compile for size (-Os vs -Og). Saves ~190 KB flash.
CONFIG_COMPILER_OPTIMIZATION_SIZE=y
CONFIG_BOOTLOADER_COMPILER_OPTIMIZATION_SIZE=y

# Strip DEBUG/VERBOSE log strings from binary at compile time.
CONFIG_LOG_DEFAULT_LEVEL_INFO=y
CONFIG_LOG_MAXIMUM_LEVEL_INFO=y

# Disable IPv6 — saves ~20-40 KB flash + RAM.
# CONFIG_LWIP_IPV6 is not set

# Moderate WiFi buffer reduction — frees heap RAM for WAMR.
# Defaults: 10 static RX, 32 dynamic RX.
CONFIG_ESP_WIFI_STATIC_RX_BUFFER_NUM=6
CONFIG_ESP_WIFI_DYNAMIC_RX_BUFFER_NUM=16

# Disable mDNS queries in LwIP DNS resolver.
# CONFIG_LWIP_DNS_SUPPORT_MDNS_QUERIES is not set

# Use common CA bundle instead of full (~70 KB savings).
CONFIG_MBEDTLS_CERTIFICATE_BUNDLE=y
CONFIG_MBEDTLS_CERTIFICATE_BUNDLE_DEFAULT_CMN=y
```

## platforms/esp32/sdkconfig.defaults.esp32p4
```kconfig
# ESP32-P4 early silicon (rev 1.x) — lower minimum chip revision
CONFIG_ESP_REV_MIN_FULL=100

# Override console: USB Serial/JTAG may not work on early P4 silicon
CONFIG_ESP_CONSOLE_USB_SERIAL_JTAG=n
CONFIG_ESP_CONSOLE_UART_DEFAULT=y
```
